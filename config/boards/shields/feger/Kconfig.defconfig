## config/boards/shields/feger/Kconfig.defconfig
```kconfig
# Copyright (c) 2020 The ZMK Contributors
# SPDX-License-Identifier: MIT

if SHIELD_FEGER_LEFT

config ZMK_KEYBOARD_NAME
    default "Feger"

config ZMK_SPLIT_ROLE_CENTRAL
    default n

endif

if SHIELD_FEGER_LEFT || SHIELD_FEGER_RIGHT

config ZMK_SPLIT
    default y

endif
```

## config/boards/shields/feger/Kconfig.shield
```kconfig
# Copyright (c) 2020 The ZMK Contributors
# SPDX-License-Identifier: MIT

config SHIELD_FEGER_LEFT
    def_bool $(shields_list_contains,feger_left)

config SHIELD_FEGER_RIGHT
    def_bool $(shields_list_contains,feger_right)
```
